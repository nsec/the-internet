## image/configs/nsec_defconfig
```kconfig
BR2_x86_64=y
BR2_TOOLCHAIN_BUILDROOT_MUSL=y
# BR2_TARGET_ENABLE_ROOT_LOGIN is not set
# BR2_TARGET_GENERIC_REMOUNT_ROOTFS_RW is not set
BR2_ROOTFS_USERS_TABLES="$(BR2_EXTERNAL)/Makeusers"
BR2_ROOTFS_OVERLAY="$(BR2_EXTERNAL)/rootfs_overlay/"
BR2_PACKAGE_BUSYBOX_SHOW_OTHERS=y
BR2_PACKAGE_IFUPDOWN=y
BR2_PACKAGE_IPROUTE2=y
BR2_PACKAGE_IPTABLES=y
BR2_PACKAGE_IPUTILS=y
BR2_PACKAGE_QUAGGA=y
BR2_PACKAGE_QUAGGA_ZEBRA=y
BR2_PACKAGE_QUAGGA_BGPD=y
BR2_PACKAGE_QUAGGA_BGP_ANNOUNCE=y
BR2_PACKAGE_QUAGGA_WATCHQUAGGA=y
BR2_PACKAGE_QUAGGA_VTYSH=y
BR2_PACKAGE_TCPDUMP=y
```
